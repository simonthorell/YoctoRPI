## layer/conf/layer.conf
```bitbake
# We have a conf and classes directory, add to BBPATH
BBPATH .= ":${LAYERDIR}"

# We have recipes-* directories, add to BBFILES
BBFILES += "${LAYERDIR}/recipes-*/*/*.bb \
            ${LAYERDIR}/recipes-*/*/*.bbappend"

BBFILE_COLLECTIONS += "layer"
BBFILE_PATTERN_layer = "^${LAYERDIR}/"
BBFILE_PRIORITY_layer = "6"

LAYERDEPENDS_layer = "core"
LAYERSERIES_COMPAT_layer = "scarthgap"
```

## meta-lager/conf/distro/custom-distro.conf
```bitbake
#Include poky.conf
require /yocto/sources/poky/meta-poky/conf/distro/poky.conf 

DISTRO = "custom-distro"
DISTRO_NAME = "Nackademin OS"
DISTRO_CODENAME = "Tomteboda"
DISTRO_VERSION = "0.0.1"

# Use systemd as the init system
INIT_MANAGER = "systemd"

# Add hello-world recipe to the image
IMAGE_INSTALL:append = " hello-internet"
```

## meta-lager/conf/layer.conf
```bitbake
# We have a conf and classes directory, add to BBPATH
BBPATH .= ":${LAYERDIR}"

# We have recipes-* directories, add to BBFILES
BBFILES += "${LAYERDIR}/recipes-*/*/*.bb \
            ${LAYERDIR}/recipes-*/*/*.bbappend"

BBFILE_COLLECTIONS += "meta-lager"
BBFILE_PATTERN_meta-lager = "^${LAYERDIR}/"
BBFILE_PRIORITY_meta-lager = "6"

LAYERDEPENDS_meta-lager = "core"
LAYERSERIES_COMPAT_meta-lager = "scarthgap"
```

## meta_lager/conf/distro/custom-distro.conf
```bitbake
DISTRO = "custom-distro"
DISTRO_NAME = "Nackademin Linux"
DISTRO_VERSION = "0.0.1"

require conf/distro/include/poky.conf
```

## meta_lager/conf/layer.conf
```bitbake
# We have a conf and classes directory, add to BBPATH
BBPATH .= ":${LAYERDIR}"

# We have recipes-* directories, add to BBFILES
BBFILES += "${LAYERDIR}/recipes-*/*/*.bb \
            ${LAYERDIR}/recipes-*/*/*.bbappend"

BBFILE_COLLECTIONS += "meta_lager"
BBFILE_PATTERN_meta_lager = "^${LAYERDIR}/"
BBFILE_PRIORITY_meta_lager = "6"

LAYERDEPENDS_meta_lager = "core"
LAYERSERIES_COMPAT_meta_lager = "scarthgap"
```
